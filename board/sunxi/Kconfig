## board/sunxi/Kconfig
```kconfig
choice
	prompt "SPL Image Type"
	default SPL_IMAGE_TYPE_SUNXI_EGON

config SPL_IMAGE_TYPE_SUNXI_EGON
	bool "eGON (normal)"
	help
	  Select this option to embed the SPL binary in an eGON.BT0 image,
	  which is compatible with the normal boot ROM (NBROM).

	  This is usually the correct option to choose.

config SPL_IMAGE_TYPE_SUNXI_TOC0
	bool "TOC0 (secure)"
	help
	  Select this option to embed the SPL binary in a TOC0 image,
	  which is compatible with the secure boot ROM (SBROM).

endchoice

config SPL_IMAGE_TYPE
	string
	default "sunxi_egon" if SPL_IMAGE_TYPE_SUNXI_EGON
	default "sunxi_toc0" if SPL_IMAGE_TYPE_SUNXI_TOC0

config H713_VENDOR_CHAINLOAD
	bool "H713: one-shot chainload of the vendor boot chain"
	depends on MACH_SUN50I_H713
	default n
	help
	  Let the SPL hand the machine to the vendor's boot0 for exactly one
	  boot, when the RTC marker asks for it, instead of swapping the first
	  stage on eMMC.  Ours stays installed at LBA 0x10 and remains the
	  default: the marker is consumed before the handoff, so a vendor
	  excursion that hangs comes back to our own U-Boot on the next power
	  cycle.

	  The vendor's boot0 is read from LBA 0x100 and checksum-verified
	  before anything is entered; put it there with
	  tools/boot-switch.sh stage.  Nothing is written to eMMC.
```

## configs/hy310_h713_defconfig
```kconfig
CONFIG_ARM=y
CONFIG_ARCH_SUNXI=y
CONFIG_DEFAULT_DEVICE_TREE="allwinner/sun50i-h713-hy310"
CONFIG_DRAM_CLK=720
CONFIG_SPL=y
# H713/HY310 stock BT0: clk=720, type=7 (LPDDR3), zq=0x003f3ffb,
# odt/flags=0x31, para1=0x10f410f4, para2=0x04000000.
CONFIG_DRAM_SUNXI_DX_ODT=0x03030303
CONFIG_DRAM_SUNXI_DX_DRI=0x0e0e0e0e
CONFIG_DRAM_SUNXI_CA_DRI=0x1c12
CONFIG_DRAM_SUNXI_ODT_EN=0x31
CONFIG_DRAM_SUNXI_ZQ=0x003f3ffb
CONFIG_DRAM_SUNXI_PARA1=0x10f410f4
CONFIG_DRAM_SUNXI_PARA2=0x04000000
CONFIG_DRAM_SUNXI_MR0=0x00000000
CONFIG_DRAM_SUNXI_MR1=0x000000c3
CONFIG_DRAM_SUNXI_MR2=0x0000000a
CONFIG_DRAM_SUNXI_MR3=0x00000002
CONFIG_DRAM_SUNXI_TPR0=0x0049225a
CONFIG_DRAM_SUNXI_TPR1=0x01b1b1d0
CONFIG_DRAM_SUNXI_TPR2=0x0004c02c
CONFIG_DRAM_SUNXI_TPR3=0xb4787896
CONFIG_DRAM_SUNXI_TPR4=0x00000000
CONFIG_DRAM_SUNXI_TPR5=0x48484848
CONFIG_DRAM_SUNXI_TPR6=0x00000048
CONFIG_DRAM_SUNXI_TPR7=0x1621121e
CONFIG_DRAM_SUNXI_TPR8=0x00000000
CONFIG_DRAM_SUNXI_TPR9=0x00000000
CONFIG_DRAM_SUNXI_TPR10=0x00007767
CONFIG_DRAM_SUNXI_TPR11=0x44650000
CONFIG_DRAM_SUNXI_TPR12=0x00005544
CONFIG_DRAM_SUNXI_TPR13=0xb4036223
CONFIG_MACH_SUN50I_H713=y
CONFIG_SUNXI_DRAM_H713_LPDDR3_STOCK=y
CONFIG_MMC_SUNXI_SLOT_EXTRA=2
CONFIG_MMC0_CD_PIN=""
# CONFIG_SYS_MALLOC_CLEAR_ON_INIT is not set
CONFIG_SUPPORT_EMMC_BOOT=y
CONFIG_USB_EHCI_HCD=y
CONFIG_USB_OHCI_HCD=y
```
